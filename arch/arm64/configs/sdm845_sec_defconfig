## drivers/media/platform/msm/camera/Kconfig
```kconfig
config SAMSUNG_OIS_RUMBA_S4
        tristate "External RUMBA S4 ois support"
	depends on SPECTRA_CAMERA
	default n
	---help---
	Enables support for external ois module.

config SAMSUNG_OIS_RUMBA_S6
        tristate "External RUMBA S6 ois support"
	depends on SPECTRA_CAMERA
	default n
	---help---
	Enables support for external ois module.
	
config SAMSUNG_OIS_MCU_STM32
        tristate "External ois MCU STM32 support"
	depends on SPECTRA_CAMERA
	default n
	---help---
	Enables support for external ois module.

config SAMSUNG_MULTI_CAMERA
	tristate "Multi camera support"
	depends on SPECTRA_CAMERA
	default n
	---help---
	Enables support for multi camera.

config CAMERA_SYSFS_V2
	bool "CAMERA SYS"
	depends on SPECTRA_CAMERA
	---help---
	Enable support CAMERA SYS.

config SAMSUNG_FRONT_EEPROM
	tristate "Front eeprom support"
	depends on SPECTRA_CAMERA
	default n
	---help---
	Enables support for front eeprom

config SAMSUNG_SECURE_CAMERA
	tristate "Secure camera support"
	depends on SPECTRA_CAMERA
	default n
	---help---
	Enables support for secure camera

config CAMERA_DYNAMIC_MIPI
	tristate "Multi camera support"
	depends on SPECTRA_CAMERA
	default n
	---help---
	Enables support for dynamic mipi clock

config CAMERA_FRS_DRAM_TEST
	tristate "Rear camera support"
	depends on SPECTRA_CAMERA
	default n
	---help---
	Enables support for FRS DRAM test

config USE_CAMERA_HW_BIG_DATA
	bool "CAMERA HW SYS"
	depends on SPECTRA_CAMERA
	default n
	---help---
	CAMERA HW SYS.

config FLASH_CURRENT_JAPAN
	tristate "flash current for jpn"
	depends on SPECTRA_CAMERA
	default n
	---help---
	Enables support for JPN
	
config CAMERA_SSM_I2C_ENV
	tristate "Rear camera support"
	depends on SPECTRA_CAMERA
	default n
	---help---
	Enables support for SSM I2C test
```

## drivers/misc/samsung/Kconfig
```kconfig
#
# SAMSUNG device dedicated drivers
#
config SAMSUNG_PRODUCT_SHIP
	bool "set up for product shipping"
	default n

config SEC_BSP
	bool "Samsung BSP Feature"
	default n
	select MSM_BOOT_STATS
	help
	  Samsung BSP Feature.

config DRV_SAMSUNG
	bool "samsung device dedicated drivers option"
	default y
	help
	  This is driver option for samsung sec_class
	  Say y here to enable samsung classes for drivers
	  Provide option of enabling sec class
	  Supports sec drivers key, touch, sec_debug etc

config SKU_THEME
        bool "Enable SKU THEME"
        depends on SEC_BSP
        default n
        help
          This option is used to add sku theme Func.
          Say Y if you want to enable this feature.

config SEC_DEBUG_APPS_CLK_LOGGING
	bool "Enable apps clk logging"
	default n
	depends on CLOCK_CPU_OSM
	help
	  Enable apps clk logging.

config ARGOS
	bool "Throughput monitoring Feature"
	default n
	help
	  This option enables monitoring the data throughput and doing several actions for
	  enhancing the performance such as adjusting the CPU freqency, allocating the tasks
	  to the appropriate CPU and so on

menu "Samsung Factory Feature"
config SEC_FACTORY
	bool "when it comes to sec factory mode"
	default n
	select SEC_DEBUG_FORCE_ERROR
	select SEC_NAD
	select SEC_PANIC_PCIE_ERR
	help
	  It will support a sec factory mode
endmenu
```

## drivers/motor/Kconfig
```kconfig
config MOTOR_DRV_SM5720
	tristate "SM5720 motor"
	default n
	depends on MFD_SM5720 && I2C
	help
	  Say Y to enalbe MOTOR_DRV_SM5720
	  You will get supprot for that.
	  motor of SM5720 of PMIC

	  If unsure, say N.

config SS_VIBRATOR
	tristate "SS_VIBRATOR"
	default n
	help
	  Say Y to enable SAMSUNG VIBRATOR support
	  SS Vibrator
	  You will get supprot for that.

	  If unsure, say N.

config BOOST_POWER_SHARE
	bool "Boost Power Share"
	default n
	help
	  Say Y to enable Boost Power(5V) share.

config MOTOR_DRV_MAX77705
	tristate "Maxim MAX77705 motor"
	default n
	depends on MFD_MAX77705
	help
	  If you say yes here you will get support for the
	  motor of Maxim MAX77705 PMIC.
	  To enable this driver, MFD_MAX77705 should be enabled and
	  MFD_MAX77705 calls this driver.


config BLDC_VIBRATOR
	tristate "BLDC_VIBRATOR"
	default n
	help
	  Say Y to enable MOTOR BLDC drive by PMIC support
```

## drivers/sensors/Kconfig
```kconfig
config SENSORS
	bool "Sensors Class Support"
	help
	  This option enables the sensor sysfs class in /sys/class/sensors.
	  You'll need this to do anything useful with sensorss. If unsure, say N.

config SENSORS_SSC
	bool "Enable Sensors Driver Support for SSC"
	help
	  Add support for sensors SSC driver.
	  This driver is used for exercising sensors use case,
	  time syncing with ADSP clock.

config SENSORS_DELAYED_LOAD
	bool "Enable Delayed loading the Sensors firmware"
	help
	  Add support for delayed loading the Sensor firmware.
	  If there is some timing issue in booting time, Y

config SENSORS_SYSFS
	tristate "Sensors sysfs"
	help
	  Support sysfs for sensors.
          If you say yes here you get sysfs support for
	  sensor factory test.
	  To compile this driver as a module, choose M here: the
	  module will be called sensors_core.

config SENSORS_CM36672P_IRIS
	depends on I2C
	tristate "CM36672P IRIS driver"
	default n
	help
	  This option enables proximity sensor for iris using CM36672P driver.

config SENSORS_SX9320
	depends on I2C
	tristate "SX9320 driver"
	default n
	help
	  Say Y here if you use sx9320.
	  This option enables grip sensors using
	  SemTech sx9320 device driver.
	  Say N here if you do not use sx9320.
```

## security/mstdrv/Kconfig
```kconfig
# @file Kconfig
# @brief Kconfig for MST drivers
# Copyright (c) 2015-2019, Samsung Electronics Corporation. All rights reserved.
#
# This program is free software; you can redistribute it and/or modify
# it under the terms of the GNU General Public License version 2 and
# only version 2 as published by the Free Software Foundation.
#
# This program is distributed in the hope that it will be useful,
# but WITHOUT ANY WARRANTY; without even the implied warranty of
# MERCHANTABILITY or FITNESS FOR A PARTICULAR PURPOSE.  See the
# GNU General Public License for more details.

config MST_LDO
	bool "MST LDO kernel driver"
	default n
	help
	This enables the MST LDO kernel driver

config MST_REGULATOR
	bool "MST uses regulator API"
	default n
	help
	This enables regulator API code

config MST_SUPPORT_GPIO
	bool "MST uses support gpio"
	default n
	help
	This enables support gpio check code

config MST_NONSECURE
	bool "MST before TrustZone bringup"
	default n
	help
	This enables the MST operation in Normal kernel

config MST_IF_PMIC
	bool "MST is used in IF PMIC"
	default n
	help
	This enables the MST IF PMIC function

config MFC_CHARGER
	bool "MFC IC using model"
	default n
	help
	This enables the MFC IC sysfs node

config MST_TEEGRIS
	bool "MST running on TEEGRIS"
	default n
	help
	This enables the MST TEEGRIS function

config MFC_LDO_COMMAND
	bool "i2c patch for LDO on MFC IC IDT chip"
	default n
	help
	This enables the i2c patch for LDO on MFC IC IDT chip

config MST_LPM_DISABLE
	bool "MST LPM Disable, this works only in eng binary version"
	default n
	help
	This enables the MST LPM disable funtion in eng binary version

config MST_LPM_CONTROL
	bool "MST control LPM mode for performace"
	default n
	help
	This enables the MST LPM control code
```
