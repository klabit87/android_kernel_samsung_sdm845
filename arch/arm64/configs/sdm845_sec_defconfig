## arch/arm64/configs/sdm845_sec_eng_defconfig
```kconfig
CONFIG_IKCONFIG=y
CONFIG_IKCONFIG_PROC=y
# CONFIG_RCU_FAST_NO_HZ is not set
CONFIG_CGROUPS=y
CONFIG_CGROUP_DEBUG=y
CONFIG_CGROUP_SCHED=y
# CONFIG_SCHED_AUTOGROUP is not set
CONFIG_SLUB_DEBUG=y
# CONFIG_BLK_DEV_BSG is not set
# CONFIG_IOSCHED_DEADLINE is not set
CONFIG_CLEANCACHE=y
# CONFIG_ARM64_REG_REBALANCE_ON_CTX_SW is not set
# CONFIG_BALANCE_ANON_FILE_RECLAIM is not set
CONFIG_FORCE_ALLOC_FROM_DMA_ZONE=y
# CONFIG_EFI is not set
CONFIG_CP15_BARRIER_EMULATION=y
CONFIG_SETEND_EMULATION=y
CONFIG_PM_DEBUG=y
CONFIG_CPU_FREQ_STAT=y
# CONFIG_CPU_BOOST is not set
CONFIG_L2TP_DEBUGFS=y
CONFIG_DNS_RESOLVER=y
# CONFIG_CFG80211_CRDA_SUPPORT is not set
CONFIG_PNP_DEBUG_MESSAGES=y
CONFIG_CMA_SIZE_MBYTES=40
CONFIG_CMA_DEBUGFS=y
CONFIG_UID_CPUTIME=y
# CONFIG_SKY2 is not set
# CONFIG_SMSC911X is not set
CONFIG_PHYLIB=y
CONFIG_INPUT_JOYSTICK=y
CONFIG_INPUT_KEYCHORD=y
CONFIG_INPUT_GPIO=y
# CONFIG_FB_ARMCLCD is not set
CONFIG_FB_VIRTUAL=y
# CONFIG_MMC_PARANOID_SD_INIT is not set
CONFIG_LEDS_TRIGGER_HEARTBEAT=y
CONFIG_LEDS_TRIGGER_CPU=y
CONFIG_EDAC=y
CONFIG_EDAC_MM_EDAC=y
CONFIG_EDAC_CORTEX_ARM64=y
CONFIG_EDAC_CORTEX_ARM64_PANIC_ON_CE=y
CONFIG_EDAC_CORTEX_ARM64_PANIC_ON_UE=y
CONFIG_EDAC_KRYO3XX_ARM64=y
CONFIG_EDAC_KRYO3XX_ARM64_PANIC_ON_UE=y
# CONFIG_EDAC_QCOM_LLCC is not set
# CONFIG_EDAC_QCOM_LLCC_PANIC_ON_CE is not set
# CONFIG_EDAC_QCOM_LLCC_PANIC_ON_UE is not set

# CONFIG_IOMMU_IO_PGTABLE_FAST_SELFTEST is not set
CONFIG_IOMMU_DEBUG=y
CONFIG_IOMMU_DEBUG_TRACKING=y
CONFIG_IOMMU_TESTS=y
CONFIG_QCOM_COMMON_LOG=y
CONFIG_MSM_SMD_DEBUG=y
CONFIG_MSM_SERVICE_LOCATOR=y
CONFIG_QCOM_DCC=y
CONFIG_MSM_GLADIATOR_ERP_V2=y
CONFIG_PANIC_ON_GLADIATOR_ERROR_V2=y
CONFIG_MSM_GLADIATOR_HANG_DETECT=y
CONFIG_MSM_CORE_HANG_DETECT=y
CONFIG_MSM_RUN_QUEUE_STATS=y
CONFIG_QCOM_CPUSS_DUMP=y
CONFIG_MSM_SERVICE_NOTIFIER=y
CONFIG_ARM_GIC_V3_ACL=y
CONFIG_PHY_XGENE=y
CONFIG_MSM_TZ_LOG=y
# CONFIG_EFIVAR_FS is not set
# CONFIG_NETWORK_FILESYSTEMS is not set
CONFIG_DYNAMIC_DEBUG=y
CONFIG_PAGE_OWNER=y
CONFIG_PAGE_OWNER_ENABLE_DEFAULT=y
CONFIG_DEBUG_PAGEALLOC_ENABLE_DEFAULT=y
CONFIG_SLUB_DEBUG_PANIC_ON=y
CONFIG_DEBUG_OBJECTS=y
CONFIG_DEBUG_OBJECTS_FREE=y
CONFIG_DEBUG_OBJECTS_TIMERS=y
CONFIG_DEBUG_OBJECTS_WORK=y
CONFIG_DEBUG_OBJECTS_RCU_HEAD=y
CONFIG_DEBUG_OBJECTS_PERCPU_COUNTER=y
CONFIG_SLUB_DEBUG_ON=y
CONFIG_DEBUG_KMEMLEAK=y
CONFIG_DEBUG_KMEMLEAK_EARLY_LOG_SIZE=4000
CONFIG_DEBUG_KMEMLEAK_DEFAULT_OFF=y
CONFIG_DEBUG_STACK_USAGE=y
CONFIG_DEBUG_MEMORY_INIT=y
CONFIG_LOCKUP_DETECTOR=y
CONFIG_WQ_WATCHDOG=y
CONFIG_PANIC_ON_SCHED_BUG=y
CONFIG_PANIC_ON_RT_THROTTLING=y
CONFIG_SCHED_STACK_END_CHECK=y
CONFIG_DEBUG_SPINLOCK=y
CONFIG_DEBUG_MUTEXES=y
CONFIG_DEBUG_ATOMIC_SLEEP=y
CONFIG_DEBUG_LIST=y
CONFIG_FAULT_INJECTION=y
CONFIG_FAIL_PAGE_ALLOC=y
CONFIG_UFS_FAULT_INJECTION=y
CONFIG_FAULT_INJECTION_DEBUG_FS=y
CONFIG_FAULT_INJECTION_STACKTRACE_FILTER=y
CONFIG_QCOM_RTB=y
CONFIG_QCOM_RTB_SEPARATE_CPUS=y
#CONFIG_FUNCTION_TRACER=y
#CONFIG_IRQSOFF_TRACER=y
CONFIG_TRACER_SNAPSHOT=y
#CONFIG_BLK_DEV_IO_TRACE=y
CONFIG_MEMTEST=y
CONFIG_PANIC_ON_DATA_CORRUPTION=y
CONFIG_ARM64_PTDUMP=y
CONFIG_PID_IN_CONTEXTIDR=y
CONFIG_FREE_PAGES_RDONLY=y
CONFIG_CORESIGHT=y
CONFIG_CORESIGHT_LINK_AND_SINK_TMC=y
CONFIG_CORESIGHT_SOURCE_ETM4X=y
CONFIG_CORESIGHT_REMOTE_ETM=y
CONFIG_CORESIGHT_REMOTE_ETM_DEFAULT_ENABLE=0
CONFIG_CORESIGHT_QCOM_REPLICATOR=y
CONFIG_CORESIGHT_STM=y
CONFIG_CORESIGHT_HWEVENT=y
CONFIG_CORESIGHT_CTI=y
CONFIG_CORESIGHT_TPDA=y
CONFIG_CORESIGHT_TPDM=y
CONFIG_CORESIGHT_QPDI=y
CONFIG_CORESIGHT_SOURCE_DUMMY=y
CONFIG_XZ_DEC=y
CONFIG_SEC_DEBUG_FORCE_ERROR=y
CONFIG_USER_RESET_DEBUG_TEST=y
CONFIG_SEC_DEBUG_SEC_WDOG_BITE=y
CONFIG_SEC_GPIO_DVS=y
CONFIG_ENG_BATTERY_CONCEPT=y
CONFIG_CPU_FREQ_GOV_USERSPACE=y

# Maxim 77705 USBC Debug
CONFIG_CCIC_MAX77705_DEBUG=y

# ABC Hub bootc eng mode
CONFIG_SEC_ABC_HUB_BOOTC_ENG=y

# Rooting Prevention
# CONFIG_SEC_RESTRICT_ROOTING is not set
# CONFIG_SEC_RESTRICT_SETUID is not set
# CONFIG_SEC_RESTRICT_FORK is not set
# CONFIG_SEC_RESTRICT_ROOTING_LOG is not set
CONFIG_REGMAP_ALLOW_WRITE_DEBUGFS=y
CONFIG_SEC_BSP_PCIE_DEV=y

# Security
# CONFIG_TIMA_LKMAUTH is not set
# CONFIG_TIMA_LKM_BLOCK is not set
# CONFIG_RKP_KDP is not set
# CONFIG_RKP_NS_PROT is not set
# CONFIG_RKP_CFP_TEST is not set

# SDP KeyManagement Test for MDFPP evaluation
CONFIG_SDP_KEY_DUMP=y

CONFIG_VIDEO_ADV_DEBUG=y
CONFIG_DEBUG_TASK_USAGE=y

# MPSD
CONFIG_MPSD_DEBUG=y
```

## arch/arm64/configs/sdm845_sec_star2qlte_usa_single_defconfig
```kconfig
# sdm845_sec_starqlte_usa_single_defconfig

CONFIG_SEC_STAR2QLTE_PROJECT=y
CONFIG_MACH_STAR2QLTE_SINGLE=y

# Sub PMIC
CONFIG_REGULATOR_S2ABB01=y
CONFIG_REGULATOR_S2DOS03=y
CONFIG_REGULATOR_S2DOS05=y
# CONFIG_REGULATOR_MAX77838 is not set
CONFIG_MFD_S2MPB02=y
CONFIG_REGULATOR_S2MPB02=y
CONFIG_REGULATOR_S2MPB03=y

# gpio expander
CONFIG_GPIO_PCAL6524=y

CONFIG_SWITCH=y

# input device
CONFIG_TOUCHSCREEN_SEC_TS=y

# display
CONFIG_PANEL_S6E3HA6_AMS622MR01_WQHD=y
CONFIG_PANEL_S6E3HA8_AMB622NP01_WQHD=y

# MUIC configs
CONFIG_MFD_CORE=y
CONFIG_USE_MUIC=y
CONFIG_USE_SAFEOUT=y
CONFIG_MUIC_NOTIFIER=y
CONFIG_AFC_CHARGER_MODE=y
CONFIG_MUIC_SUPPORT_RUSTPROOF=y
CONFIG_VBUS_NOTIFIER=y
CONFIG_VBUS_NOTIFIER_WORK=y
CONFIG_MUIC_MAX77705=y
CONFIG_MFD_MAX77705=y
CONFIG_MUIC_MAX77705_CCIC=y
CONFIG_HV_MUIC_MAX77705_AFC=y
CONFIG_MUIC_SUPPORT_CCIC=y
CONFIG_MUIC_UNIVERSAL=y
CONFIG_AFC_CHARGER_MODE=y
CONFIG_MFD_SM5720=y
CONFIG_MUIC_UNIVERSAL_SM5720=y
CONFIG_MUIC_HV=y
CONFIG_HICCUP_CHARGER=y

CONFIG_LEDS_SM5720_RGB=y

# BATTERY
CONFIG_CALC_TIME_TO_FULL=y
CONFIG_BATTERY_AGE_FORECAST=y
CONFIG_AFC_CURR_CONTROL_BY_TEMP=y
CONFIG_LIMIT_CHARGING_DURING_CALL=y
CONFIG_ENABLE_100MA_CHARGING_BEFORE_USB_CONFIGURED=y
CONFIG_SAMSUNG_LPM_MODE=y
CONFIG_CHARGER_SM5720=y
CONFIG_FUELGAUGE_SM5720=y
CONFIG_FUELGAUGE_MAX77705=y
CONFIG_CHARGER_MAX77705=y
CONFIG_WIRELESS_CHARGER_MFC=y
CONFIG_WIRELESS_FIRMWARE_UPDATE=y
CONFIG_BATTERY_CISD=y

#ccic
CONFIG_CCIC_MAX77705=y
# CONFIG_CCIC_S2MM003 is not set
CONFIG_CCIC_S2MM005=y

#displayport
CONFIG_SEC_DISPLAYPORT=y
CONFIG_SEC_DISPLAYPORT_LOGGER=y
CONFIG_SEC_DISPLAYPORT_BIGDATA=y

# BLUETOOTH
CONFIG_BT=y
CONFIG_BT_BCM4361=y
CONFIG_BT_BLUESLEEP=y
CONFIG_RFKILL=y

#motor
CONFIG_MOTOR_DRV_SM5720=y
CONFIG_MOTOR_DRV_MAX77705=y
CONFIG_SS_VIBRATOR=y
CONFIG_BOOST_POWER_SHARE=y

#SVCLED
CONFIG_LEDS_MAX77705_RGB=y

#sensor
CONFIG_SENSORS=y
CONFIG_ADSP_FACTORY=y
CONFIG_LSM6DSL_FACTORY=y
CONFIG_AK09916C_FACTORY=y
CONFIG_LPS22HB_FACTORY=y
CONFIG_TMD490X_FACTORY=y
CONFIG_SUPPORT_TMD4906_FACTORY=y
CONFIG_SUPPORT_PROX_AUTO_CAL=y
CONFIG_SUPPORT_HIDDEN_HOLE=y
CONFIG_SUPPORT_MOBEAM=y
CONFIG_SLPI_MOTOR=y
CONFIG_SENSORS_DELAYED_LOAD=y

#hrm sensor
CONFIG_SENSORS_MAX86915=y

#grip sensor
CONFIG_SENSORS_SX9320=y

# Fingerprint sensor
CONFIG_SENSORS_FINGERPRINT=y
CONFIG_SENSORS_ET5XX=y
CONFIG_SENSORS_FP_SPI_NUMBER=5
CONFIG_SENSORS_FP_SPI_GPIO_START=85
CONFIG_SENSORS_FP_SPI_GPIO_END=88

# NFC ESE
CONFIG_SAMSUNG_NFC=y
CONFIG_NFC_PN547=y
CONFIG_NFC_PN547_ESE_SUPPORT=y
CONFIG_ESE_SECURE=y
CONFIG_ESE_SPI_GPIO_START=27
CONFIG_ESE_SPI_GPIO_END=30
CONFIG_ESE_SPI_NUMBER=2
CONFIG_SEC_NFC_LOGGER=y

# FM radio
CONFIG_MEDIA_RADIO_SUPPORT=y
CONFIG_I2C_RTC6213N=y
CONFIG_RADIO_RTC6213N=y

# Camera
CONFIG_LEDS_S2MPB02=y
#CONFIG_SAMSUNG_OIS_RUMBA_S4=y
CONFIG_SAMSUNG_OIS_RUMBA_S6=y
CONFIG_SAMSUNG_FRONT_EEPROM=y
CONFIG_CAMERA_SYSFS_V2=y
CONFIG_SAMSUNG_SECURE_CAMERA=y
CONFIG_SAMSUNG_MULTI_CAMERA=y
CONFIG_CAMERA_DYNAMIC_MIPI=y
CONFIG_CAMERA_FRS_DRAM_TEST=y
CONFIG_USE_CAMERA_HW_BIG_DATA=y

# SSWAP
CONFIG_SWAP=y
CONFIG_FRONTSWAP=y
CONFIG_ZSMALLOC=y
CONFIG_ZSMALLOC_STAT=y
CONFIG_PGTABLE_MAPPING=y
CONFIG_ZSWAP=y
CONFIG_ZSWAP_MIGRATION_SUPPORT=y
CONFIG_ZSWAP_ENABLE_WRITEBACK=n
CONFIG_ZSWAP_SAME_PAGE_SHARING=n
CONFIG_ZPOOL=y
CONFIG_DIRECT_RECLAIM_FILE_PAGES_ONLY=y
CONFIG_INCREASE_MAXIMUM_SWAPPINESS=y
CONFIG_FIX_INACTIVE_RATIO=y
CONFIG_TIGHT_PGDAT_BALANCE=y
CONFIG_VNSWAP=y
CONFIG_SWAP_ENABLE_READAHEAD=n
CONFIG_RBIN=y

# Linux On Dex
CONFIG_USER_NS=y
CONFIG_POSIX_MQUEUE=y
CONFIG_VETH=y
CONFIG_UTS_NS=y
CONFIG_PID_NS=y
CONFIG_CGROUP_PIDS=y
CONFIG_CGROUP_DEVICE=y
CONFIG_MEMCG=y
CONFIG_MEMCG_SWAP=y
CONFIG_NET_CLS_CGROUP=y
CONFIG_LOD_SEC=y

# Audio
#CONFIG_SLIMBUS_DEBUG is not set
```

## arch/arm64/configs/sdm845_sec_userdebug_defconfig
```kconfig
CONFIG_GATOR=y

# CONFIG_RKP_KDP is not set
# CONFIG_RKP_NS_PROT is not set

#
# Samsung Rooting Restriction Feature
#
# CONFIG_SEC_RESTRICT_ROOTING is not set
# CONFIG_SEC_RESTRICT_SETUID is not set
# CONFIG_SEC_RESTRICT_FORK is not set
# CONFIG_SEC_RESTRICT_ROOTING_LOG is not set

# streamline
CONFIG_PROFILING=y
CONFIG_PERF_EVENTS=y
CONFIG_HIGH_RES_TIMERS=y
CONFIG_HW_PERF_EVENTS=y
CONFIG_LOCAL_TIMERS=y
```

## drivers/adsp_factory/Kconfig
```kconfig
#
# factory sensor drivers configuration
#
config ADSP_FACTORY
	tristate "MSM ADSP factory driver"
	default n
	help
	  This driver communicate with SSC DAEMON.
	  register each sensor device.
	  send selftest request using netlink.
	  receive test result using netlink.

config LSM6DSL_FACTORY
	tristate "factory test for SSC - LSM6DSL"
	default n
	help
	  lsm6dsl factory driver.
	  provide sysfs for factory test.
	  request selftest to adsp_factory.
	  receive test result from adsp_factory.

config AK09916C_FACTORY
	tristate "factory test for SSC - ak09916c"
	default n
	help
	  ak09916c factory driver.
	  provide sysfs for factory test.
	  request selftest to adsp_factory.
	  receive test result from adsp_factory.

config LPS22HB_FACTORY
	tristate "factory test for SSC - lps22hb"
	default n
	help
	  lps22hb factory driver.
	  provide sysfs for factory test.
	  request selftest to adsp_factory.
	  receive test result from adsp_factory.

config TMD490X_FACTORY
	tristate "factory test for SSC - tmd490x"
	default n
	help
	  tmd490x factory driver.
	  provide sysfs for factory test.
	  request selftest to adsp_factory.
	  receive test result from adsp_factory.

config SUPPORT_TMD4906_FACTORY
	tristate "factory test for SSC - tmd4906"
	depends on TMD490X_FACTORY
	default n
	help
	  tmd4906 factory driver
	  provide sysfs for factory test.
	  request selftest to adsp_factory.
	  receive test result from adsp_factory.

config SUPPORT_PROX_AUTO_CAL
	tristate "Support Auto Calibration for proximity sensor - tmd490x"
	default n
	depends on TMD490X_FACTORY
	help
	  Support the Auto Calibration function in tmd490x.
	  provide sysfs for factory test.
	  request selftest to adsp_factory.
	  receive test result from adsp_factory.

config SUPPORT_HIDDEN_HOLE
	tristate "Support Hidden Hole function for proximity sensor"
	default n
	depends on ADSP_FACTORY
	help
	  Support the Hidden Hole function.
	  provide sysfs for factory test.
	  request selftest to adsp_factory.
	  receive test result from adsp_factory.

config SLPI_MOTOR
	tristate "Sensors support motor"
	default n
	help
	  Support the motor state function
	  provide sysfs for factory test.
	  request selftest to adsp_factory.
	  receive test result from adsp_factory.

config SUPPORT_MOBEAM
	tristate "Sensors support mobeam"
	default n
	help
	  Support the mobeam
	  provide sysfs for factory test.
	  request selftest to adsp_factory.
	  receive test result from adsp_factory.
```

## drivers/fingerprint/Kconfig
```kconfig
#
# Sensor  drivers configuration
#
menuconfig SENSORS_FINGERPRINT
	bool "Finger Print Sensor devices"
	help
	  Say Y here, and a list of sensors drivers will be displayed.
	  Everything that didn't fit into the other categories is here. This option
	  doesn't affect the kernel.

if SENSORS_FINGERPRINT

config SENSORS_ET5XX
	tristate "ET5XX fingerprint sensor support"
	default n
	help
	  If you say yes here you get support for Egistec's
	  fingerprint sensor ET5XX.

config SENSORS_QBT1000
	tristate "QBT1000 fingerprint sensor support"
	default n
	help
	  If you say yes here you get support for Qualcomm's
	  fingerprint sensor QBT1000.

endif # SENSORS_FINGERPRINT
```

## drivers/five/five_tee_driver/Kconfig
```kconfig
#
# TEE Driver configuration
#

config FIVE_TEE_DRIVER
    bool "Integrity TEE Driver"
    depends on FIVE && QSEECOM
    default y
    help
      Enable Integrity Trusted Execution Environment support

config TEE_DRIVER_DEBUG
    bool "Integrity TEE Driver Debug mode"
    depends on FIVE_TEE_DRIVER
    default n
    help
      Enable Debug mode in TEE Driver
```

## drivers/gpu/drm/msm/samsung/Kconfig
```kconfig
config SAMSUNG_DEBUG_DISPLAY
	bool "Add Samsung Debugging code"
	default n

config DISPLAY_SAMSUNG
	depends on DRM_MSM
	bool "mdss config for samsung product"
	default n
	---help---
	Mdss config signature for samsung product

config DISPLAY_USE_INFO
	depends on DISPLAY_SAMSUNG
	bool "Support display use info logging"
	default n

#
#	PANEL UNIQUE FEATURE
#
config DUAL_PANEL
	depends on DISPLAY_SAMSUNG
	bool "dual paneloperation"
	default n
	---help---
	dual panel operation support

config PARTIAL_UPDATE
	depends on DISPLAY_SAMSUNG
	bool "partial update operation"
	default n
	---help---
	partial update operation support

config CABC_FUNCTION
	depends on DISPLAY_SAMSUNG
	bool "DDI cabc operation"
	default n
	---help---
	DDI cabc operation support

config SUPPORT_POC_FLASH
	depends on DISPLAY_SAMSUNG
	bool "SUPPORT POC FLASH"
	default n
	---help---
	SUPPORT_POC_FLASH FOR DREAM2 ONLY

#
#	HOW TO MAKE DEF-CONFIG NAME FOR PANEL
#
#	PANEL_DDI-model_PANEL-model_RESOLUTION
#	PANEL_S6E3FA2    _AMS510CV01_FHD
#	PANEL_S6E3FA2_AMS510CV01_FHD
#

config PANEL_S6E3HA6_AMB632NF01_WQHD
	depends on DISPLAY_SAMSUNG
	bool "LSI S6E3HA6 LDI"
	default n
	---help---
	LSI S6E3HA6 LDI 1440_2560 GREAT DSC


config PANEL_S6E3HA6_AMS622MR01_WQHD
	depends on DISPLAY_SAMSUNG
	bool "LSI S6E3HA6 LDI"
	default n
	---help---
	LSI S6E3HA6 LDI 1440_2560 DREAM2 DSC

config PANEL_S6E3HA6_AMB577MQ01_WQHD
	depends on DISPLAY_SAMSUNG
	bool "LSI S6E3HA6 LDI"
	default n
	---help---
	LSI S6E3HA6 LDI 1440_2560 DREAM DSC

config PANEL_S6E3FA5_AMS420MS01_FHD
	depends on DISPLAY_SAMSUNG
	bool "LSI S6E3FA5 LDI"
	default n
	---help---
	LSI S6E3FA5 LDI 1080_1920 KELLY

config PANEL_S6E3HA8_AMB622NP01_WQHD
	depends on DISPLAY_SAMSUNG
	bool "LSI S6E3HA8 LDI"
	default n
	---help---
	LSI S6E3HA8 LDI 1440_2560 STAR2 DSC


config PANEL_S6E3HA8_AMB577PX01_WQHD
	depends on DISPLAY_SAMSUNG
	bool "LSI S6E3HA8 LDI"
	default n
	---help---
	LSI S6E3HA8 LDI 1440_2560 STAR DSC

config PANEL_S6E3HA8_AMB638RD01_WQHD
	depends on DISPLAY_SAMSUNG
	bool "LSI S6E3HA8 LDI"
	default n
	---help---
	LSI S6E3HA8 LDI 1440_2560 CROWN DSC

config PANEL_S6E3FA5_AMS420QW01_FHD
	depends on DISPLAY_SAMSUNG
	bool "LSI S6E3FA5 LDI"
	default n
	---help---
	LSI S6E3FA5 LDI 1080_1920 LYKAN
```
