/* Copyright (c) 2012, The Linux Foundation. All rights reserved.
 *
 * This program is free software; you can redistribute it and/or modify
 * it under the terms of the GNU General Public License version 2 and
 * only version 2 as published by the Free Software Foundation.
 *
 * This program is distributed in the hope that it will be useful,
 * but WITHOUT ANY WARRANTY; without even the implied warranty of
 * MERCHANTABILITY or FITNESS FOR A PARTICULAR PURPOSE.  See the
 * GNU General Public License for more details.
 */

&qupv3_se14_i2c {
	status = "ok";

	pinctrl-0 = <&qupv3_se14_i2c_active &s2mm005_irq_active>;
	pinctrl-1 = <&qupv3_se14_i2c_sleep &s2mm005_irq_suspend>;

	usbpd-s2mm005@33 {
		compatible = "sec-s2mm005,i2c";
		reg = <0x33>;
		interrupt-parent = <&tlmm>;
		usbpd,usbpd_int = <&tlmm 113 0>;
		usbpd,s2mm005_fw_product_id = <0x0A>;
	};
};
