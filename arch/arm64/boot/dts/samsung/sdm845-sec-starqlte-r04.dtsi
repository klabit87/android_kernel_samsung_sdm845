/* Copyright (c) 2016-2017, The Linux Foundation. All rights reserved.
 *
 * This program is free software; you can redistribute it and/or modify
 * it under the terms of the GNU General Public License version 2 and
 * only version 2 as published by the Free Software Foundation.
 *
 * This program is distributed in the hope that it will be useful,
 * but WITHOUT ANY WARRANTY; without even the implied warranty of
 * MERCHANTABILITY or FITNESS FOR A PARTICULAR PURPOSE.  See the
 * GNU General Public License for more details.
 */

#include "sdm845-sec-starqlte-r03.dtsi"

&soc {
	i2c_20: i2c@20{ /* FM Radio (Richwave) */
		rtcfmradio@64 {
			interrupts = <145 0x0>;
			fmint-gpio = <&tlmm 145 0>; /* FM_INT */
		};
	};
};

